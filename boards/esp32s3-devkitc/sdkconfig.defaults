## boards/esp32s3-devkitc/sdkconfig.defaults
```kconfig
# ESP32-S3-DevKitC-1: 8MB flash, OPI PSRAM
CONFIG_ESPTOOLPY_FLASHSIZE_8MB=y
CONFIG_ESPTOOLPY_FLASHSIZE="8MB"

# OPI PSRAM
CONFIG_SPIRAM=y
CONFIG_SPIRAM_MODE_OCT=y
CONFIG_SPIRAM_SPEED_80M=y
CONFIG_SPIRAM_FETCH_INSTRUCTIONS=y
CONFIG_SPIRAM_RODATA=y

# DuneOS kernel driver selection — generated by duneos-bspgen
CONFIG_DUNEOS_DRV_NULL=y
CONFIG_DUNEOS_DRV_UART=y
CONFIG_DUNEOS_DRV_KLOG=y
CONFIG_DUNEOS_DRV_GPIO=y
CONFIG_DUNEOS_DRV_I2C=y
```

## components/duneos_loader/Kconfig
```kconfig
menu "DuneOS Loader"

    config DUNEOS_EXEC_POOL_KB
        int "Executable section pool size (KB)"
        depends on IDF_TARGET_ARCH_XTENSA
        range 16 256
        default 64
        help
            On Xtensa targets, executable sections (.text, .literal) are loaded
            into a static IRAM_ATTR pool so the linker guarantees correct placement
            in true IRAM.  This avoids the DRAM-heap arithmetic that is
            chip-specific and can land allocations in the data-cache region.
            Set this large enough for the biggest .dap you expect to load.

endmenu
```

## kernel/duneos_loader/Kconfig
```kconfig
menu "DuneOS Loader"

    config DUNEOS_EXEC_POOL_KB
        int "Executable section pool size (KB)"
        depends on IDF_TARGET_ARCH_XTENSA
        range 16 256
        default 64
        help
            On Xtensa targets, executable sections (.text, .literal) are loaded
            into a static IRAM_ATTR pool so the linker guarantees correct placement
            in true IRAM.  This avoids the DRAM-heap arithmetic that is
            chip-specific and can land allocations in the data-cache region.
            Set this large enough for the biggest .dap you expect to load.

    config DUNEOS_TARGET_QEMU
        bool "Target is an emulator, not real silicon"
        depends on IDF_TARGET_ARCH_XTENSA
        default n
        help
            Declare that this build only ever runs under an emulator. Set from
            `qemu: true` in board.yaml by duneos-bspgen; never set it by hand,
            and never on a board that exists physically.

            Its single effect is in the loader: qemu-xtensa's esp32s3 machine
            does not alias the IRAM and DRAM windows of internal SRAM, so the
            loader writes an app's relocated .text straight at the exec (IRAM)
            address instead of through the DRAM alias real silicon requires.
            That write path is INCORRECT on hardware — IRAM is 32-bit-access-
            only there and the loader stores unaligned bytes into the
            instruction stream. See SPEC-leg-29 and docs/qemu-test-bench.md.

            The meaning is deliberately narrow: "internal SRAM is not
            dual-mapped here". It is not a general "relax things on the
            emulator" switch.

endmenu
```

## sdkconfig.defaults.esp32s3-devkitc
```kconfig
# Flash — DevKitC-1 = 8MB
CONFIG_ESPTOOLPY_FLASHSIZE_8MB=y
CONFIG_ESPTOOLPY_FLASHSIZE="8MB"

# OPI PSRAM — ESP32-S3-DevKitC-1
CONFIG_SPIRAM=y
CONFIG_SPIRAM_MODE_OCT=y
CONFIG_SPIRAM_SPEED_80M=y
CONFIG_SPIRAM_FETCH_INSTRUCTIONS=y
CONFIG_SPIRAM_RODATA=y
```
